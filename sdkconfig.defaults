## sdkconfig.defaults
```kconfig
# --- Target chip ---
CONFIG_IDF_TARGET="esp32c3"

# --- Flash: 8MB ---
CONFIG_ESPTOOLPY_FLASHSIZE_8MB=y
CONFIG_ESPTOOLPY_HEADER_FLASHSIZE_UPDATE=n

# --- Partitions: NVS + PHY + 3MB app ---
CONFIG_PARTITION_TABLE_CUSTOM=y
CONFIG_PARTITION_TABLE_CUSTOM_FILENAME="partitions.csv"
CONFIG_PARTITION_TABLE_FILENAME="partitions.csv"

# --- Console: USB-Serial-JTAG (C3 native USB) ---
CONFIG_ESP_CONSOLE_USB_SERIAL_JTAG=y
CONFIG_ESP_CONSOLE_SECONDARY_NONE=y

# --- WiFi: 缩减缓冲区节省 RAM（无 PSRAM）---
CONFIG_ESP_WIFI_STATIC_RX_BUFFER_NUM=5
CONFIG_ESP_WIFI_DYNAMIC_RX_BUFFER_NUM=16
CONFIG_ESP_WIFI_DYNAMIC_TX_BUFFER_NUM=16
CONFIG_ESP_WIFI_RX_BA_WIN=4
CONFIG_ESP_WIFI_TX_BA_WIN=4

# --- MQTT: 关闭不需要的传输 + 缩减缓冲 ---
CONFIG_MQTT_TRANSPORT_SSL=y
# CONFIG_MQTT_TRANSPORT_WEBSOCKET is not set
CONFIG_MQTT_USE_CUSTOM_CONFIG=y
CONFIG_MQTT_BUFFER_SIZE=8192

# --- LVGL: 使用系统堆 malloc, 无 PSRAM 必须省内存 ---
CONFIG_LV_COLOR_DEPTH_16=y
CONFIG_LV_FONT_MONTSERRAT_14=y
CONFIG_LV_FONT_MONTSERRAT_20=y
CONFIG_LV_FONT_MONTSERRAT_28=y
CONFIG_LV_FONT_MONTSERRAT_48=y
CONFIG_LV_USE_CLIB_MALLOC=y
CONFIG_LV_USE_CLIB_STRING=y
CONFIG_LV_USE_CLIB_SPRINTF=y

# --- System ---
CONFIG_FREERTOS_HZ=1000

# --- 关闭蓝牙（节省 RAM）---
# CONFIG_BT_ENABLED is not set

# --- TLS: 跳过服务器证书验证（拓竹自签名证书） ---
CONFIG_ESP_TLS_INSECURE=y
CONFIG_ESP_TLS_SKIP_SERVER_CERT_VERIFY=y
```
